## CMakeLists.txt
```
#
# Copyright (c) 2019 Nordic Semiconductor
#
# SPDX-License-Identifier: LicenseRef-BSD-5-Clause-Nordic
#

cmake_minimum_required(VERSION 3.20.0)

find_package(Zephyr REQUIRED HINTS $ENV{ZEPHYR_BASE})
project(senior-gps-tracking)

zephyr_library_sources(src/semaphore.c)

zephyr_library_sources_ifdef(CONFIG_GNSS_SAMPLE_ASSISTANCE_NRF_CLOUD src/assistance.c)
zephyr_library_sources_ifdef(CONFIG_GNSS_SAMPLE_ASSISTANCE_SUPL src/assistance_supl.c)
zephyr_library_sources_ifdef(CONFIG_GNSS_SAMPLE_ASSISTANCE_MINIMAL src/assistance_minimal.c)
zephyr_library_sources_ifdef(CONFIG_GNSS_SAMPLE_ASSISTANCE_MINIMAL src/mcc_location_table.c)
```

## prj.conf
```kconfig
#General
CONFIG_FPU=y
CONFIG_NRF_MODEM_LIB=y
CONFIG_STDOUT_CONSOLE=y
CONFIG_UART_INTERRUPT_DRIVEN=y
CONFIG_NEWLIB_LIBC=y
CONFIG_NEWLIB_LIBC_FLOAT_PRINTF=y
CONFIG_PICOLIBC_IO_FLOAT=y
CONFIG_LOG=y
CONFIG_LOG_MODE_IMMEDIATE=y
CONFIG_I2C=y

## Accelerometer sample
CONFIG_SENSOR=y
CONFIG_LIS2DH=y
CONFIG_LIS2DH_TRIGGER_GLOBAL_THREAD=y

## GNSS sample

# LTE link Control
CONFIG_LTE_LINK_CONTROL=y
# request eDRX from the network
CONFIG_LTE_LC_EDRX_MODULE=y
CONFIG_LTE_EDRX_REQ=y
# PSM requested periodic TAU 8 hours
CONFIG_LTE_LC_EDRX_MODULE=y
CONFIG_LTE_PSM_REQ_RPTAU="00101000"
# PSM requested active time 6 seconds
CONFIG_LTE_PSM_REQ_RAT="00000011"
# Turn on PSM module
CONFIG_LTE_LC_PSM_MODULE=y

# AT Host library - Used to send AT commands directy from an UART terminal and to allow
#		    integration with nRF Connect for Desktop LTE Link monitor application.
CONFIG_AT_HOST_LIBRARY=y

## Networking
CONFIG_NETWORKING=y
CONFIG_NET_SOCKETS_OFFLOAD=y
CONFIG_NET_SOCKETS=y
CONFIG_POSIX_API=y
# Disable native network stack to save some memory
CONFIG_NET_NATIVE=n

# Memory and stack configuration
CONFIG_HEAP_MEM_POOL_SIZE=2048
CONFIG_MAIN_STACK_SIZE=4096
CONFIG_SYSTEM_WORKQUEUE_STACK_SIZE=1536
```

## src/semaphore.c
```c
#include <zephyr/kernel.h>

/* 1. นิยาม Semaphore: เริ่มต้นที่ค่า 0 และมีค่าสูงสุดได้ที่ 1 (Binary Semaphore) */
K_SEM_DEFINE(my_sensor_sem, 0, 1);

struct sensor_data {
    float temperature;
    float humidity;
} shared_data;

// --- Thread สำหรับอ่านค่าเซนเซอร์ ---
void sensor_thread(void *dummy1, void *dummy2, void *dummy3) {
    while (1) {
        // จำลองการอ่านค่าพิกัดพิกัดนกหรือช้าง
        shared_data.temperature = 30.5; 
        shared_data.humidity = 60.0;

        printk("Sensor: Data collected. Signaling logger...\n");

        /* 2. Give Semaphore: ส่งสัญญาณให้ Thread อื่นรู้ว่าข้อมูลพร้อมแล้ว */
        k_sem_give(&my_sensor_sem);

        k_msleep(5000); // อ่านทุกๆ 5 วินาที
    }
}

// --- Thread สำหรับบันทึกหรือส่งข้อมูล (LTE/GPS) ---
void logger_thread(void *dummy1, void *dummy2, void *dummy3) {
    while (1) {
        /* 3. Take Semaphore: รอจนกว่าจะได้สัญญาณ (รอไปเรื่อยๆ K_FOREVER) */
        if (k_sem_take(&my_sensor_sem, K_FOREVER) == 0) {
            
            // เมื่อได้ Semaphore แล้วจึงทำงานส่วนนี้
            printk("Logger: Received signal! Processing data: T=%.2f, H=%.2f\n",
                    shared_data.temperature, shared_data.humidity);
            
            // จำลองการส่งข้อมูลผ่านโมเด็ม nRF9160
        }
    }
}

// การนิยาม Thread ใน Zephyr
K_THREAD_DEFINE(sensor_tid, 1024, sensor_thread, NULL, NULL, NULL, 7, 0, 0);
K_THREAD_DEFINE(logger_tid, 1024, logger_thread, NULL, NULL, NULL, 7, 0, 0);
```
